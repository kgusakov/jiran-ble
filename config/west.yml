## config/west.yml
```yaml
manifest:
  remotes:
    - name: zmkfirmware
      url-base: https://github.com/zmkfirmware
  projects:
    - name: zmk
      remote: zmkfirmware
      revision: 9e8ee8684252aecca36c1e6f2403b0a9fd3ebf4f
      import: app/west.yml
  self:
    path: config
```
